//code to generate and feed ecg signal samples time stretched by a period suitable for the balloon
short int arr[]={101,100,100,99,99,98,97,96,93,95,95,96,97,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97,94};

short int i;

short int peak1cnt,peak2cnt,peak1index;


void setup() {
  
  
  pinMode(8, OUTPUT);//pin for the air pump
  pinMode(9,OUTPUT);//pin for vacuum pump
  Serial.begin(9600);
}


void loop() {
  
  while(1)
  {peak1cnt=peak2cnt=0;
  for(i=0;i<450;i++)
  {Serial.print(i);
  Serial.println("air pump on");
    digitalWrite(8,HIGH);
    digitalWrite(9,LOW);
    //Serial.println(arr[i]);
  if(arr[i]>106)
  {peak1cnt++;
  
    if(peak1cnt==1)//1st r
  {
  digitalWrite(8,LOW);
  digitalWrite(9,HIGH);
  Serial.print(i);
  Serial.println("vaccuum pump on");
   delay(9);
  }

  else if (peak1cnt==2) peak1index=i;
  }

  else if((arr[i]>98)&&(arr[i]<102)&&((i-peak1index)>19)&&(peak1cnt==2))
  {peak2cnt++;
  if(peak2cnt==3)//3rd t 
  {Serial.print(i);
  Serial.println("air pump on");
     digitalWrite(8,HIGH);
      digitalWrite(9,LOW);
      delay(9);
  }
    
 
  
  }

    
    
  }
   
   

  }
  
}
